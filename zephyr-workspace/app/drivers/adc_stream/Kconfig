## zephyr-workspace/app/drivers/adc_stream/Kconfig
```kconfig
# Copyright (c) 2026 Fabrizio Carlassara
# SPDX-License-Identifier: Apache-2.0

menuconfig ADC_STREAM_RPI_PICO
	bool "RP2350 continuous ADC + DMA streaming driver"
	default y
	depends on DT_HAS_RASPBERRYPI_PICO_ADC_STREAM_ENABLED
	select DMA
	select PICOSDK_USE_ADC
	help
	  App-local driver (app/drivers/adc_stream/, not an upstream Zephyr
	  driver) that free-runs the RP2350 ADC into ping-pong DMA buffers
	  for continuous acquisition. See ZEPHYR_MIGRATION.md, Phase 1b.

if ADC_STREAM_RPI_PICO

config ADC_STREAM_RPI_PICO_INIT_PRIORITY
	int "Init priority"
	default KERNEL_INIT_PRIORITY_DEVICE
	help
	  Must sort after CONFIG_DMA_INIT_PRIORITY (KERNEL_INIT_PRIORITY_DEFAULT
	  by default) — adc_stream_init() calls device_is_ready() on the DMA
	  controller device.

config ADC_STREAM_PER_CHANNEL_BUFFER_SIZE
	int "Samples per channel ping-pong half-buffer"
	default 1024
	help
		Two DMA buffers with this size times the number will be created to hold the total number of samples.

config ADC_STREAM_PER_CHANNEL_SAMPLE_RATE_HZ
	int "Sample rate for each channel in Hz"
	default 10240
	help
	  Depending on the number of channels, the total ADC sampling will be increased.

module = ADC_STREAM_RPI_PICO
module-str = adc stream
source "subsys/logging/Kconfig.template.log_config"

endif # ADC_STREAM_RPI_PICO
```

## zephyr-workspace/app/drivers/mcp4xxx/Kconfig
```kconfig
# Copyright (c) 2026 Fabrizio Carlassara
# SPDX-License-Identifier: Apache-2.0

menuconfig MCP4XXX
	bool "Microchip MCP41XX/MCP42XX SPI digital potentiometer driver"
	default y
	depends on DT_HAS_MICROCHIP_MCP41XX_ENABLED || DT_HAS_MICROCHIP_MCP42XX_ENABLED
	select SPI
	select GPIO
	help
	  App-local driver (app/drivers/mcp4xxx/) for Microchip's MCP41XX
	  (MCP4131/4151, single-channel) and MCP42XX (MCP4231/4251,
	  dual-channel) SPI digital potentiometer/rheostat family
	  (volatile/RAM wiper variants only -- see docs/ROADMAP.md for the
	  non-volatile MCP4141/4161/4241/4261). Not to be confused with the
	  older, differently-protocol'd MCP41XXX/MCP42XXX family (note the
	  extra X), which this driver does NOT support despite the
	  near-identical naming. Unlike app/drivers/adc_stream and
	  app/drivers/powman_rtc, this one doesn't deviate from an existing
	  Zephyr subsystem API -- there is no generic digital-potentiometer
	  class in Zephyr to conform to in the first place.

if MCP4XXX

config MCP4XXX_INIT_PRIORITY
	int "Init priority"
	default KERNEL_INIT_PRIORITY_DEVICE
	help
	  Must sort after CONFIG_SPI_INIT_PRIORITY and
	  CONFIG_GPIO_INIT_PRIORITY -- mcp4xxx_init() calls
	  spi_is_ready_dt() and, when shutdown-gpios is present,
	  gpio_pin_configure_dt().

module = MCP4XXX
module-str = mcp4xxx
source "subsys/logging/Kconfig.template.log_config"

endif # MCP4XXX
```

## zephyr-workspace/app/drivers/powman_rtc/Kconfig
```kconfig
menuconfig POWMAN_RTC_RPI_PICO
	bool "RP2350 POWMAN-backed RTC driver"
	default y
	depends on DT_HAS_RASPBERRYPI_PICO_POWMAN_RTC_ENABLED
	help
	  App-local driver (app/drivers/powman_rtc/) exposing RP2350's POWMAN
	  always-on timer through zephyr/drivers/rtc.h. See ZEPHYR_MIGRATION.md.
```

## zephyr-workspace/app/src/lvgl/Kconfig
```kconfig
config BOOT_TIME_WAIT_MS
  int "Time in ms to wait in the boot screen"
  default 2000
  help
    Mostly used to speed up boot time

config SCREEN_DESTROY_DELAY_MS
  int "Time to wait after screen transition to destroy previous screen"
  default 300
  help
    Has to be greater that all transision animation duration
```

## zephyr-workspace/app/src/threads/Kconfig
```kconfig
config AD_THREAD_PRIORITY
  int "Priority of ADC thread"
  default 2
  help
    This sets the priority of the thread that handles ADC DMA conversions and any messages to other threads.

config AD_THREAD_STACK_SIZE
  int "Size in bytes for the ADC thread"
  default 2048
  help
    This sets the bytes reserved for the ADC thread stack.

config UI_THREAD_PRIORITY
  int "Priority of UI thread"
  default 2
  help
    This sets the priority of the thread that handles UI and LVGL.

config UI_THREAD_STACK_SIZE
  int "Size in bytes for the UI thread"
  default 4096
  help
    This sets the bytes reserved for the UI thread stack.
```
